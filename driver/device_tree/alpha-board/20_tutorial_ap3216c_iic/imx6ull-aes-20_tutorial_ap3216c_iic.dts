/dts-v1/;

#include "imx6ull.dtsi"
#include "imx6ull-aes.dtsi"

/ {
	model = "Awesome Embedded Studio IMX6ULL Tutorial 20 - AP3216C I2C";
	compatible = "fsl,imx6ull-14x14-evk", "fsl,imx6ull";
};

/*
 * NXP EVK 参考板的 I2C1 上挂着 mag3110@0x0e 和 fxls8471@0x1e，但咱们这块 alpha 板子
 * 上一个都没有。更要命的是 fxls8471 的地址就是 0x1e，和 AP3216C 撞车——同一条 I2C
 * 总线上两个节点都声明 0x1e，i2c 核心在实例化第二个 client 的时候会直接报 EBUSY，
 * 咱们的驱动就永远 probe 不上。
 *
 * 这块板级裁剪已经收进共享的 imx6ull-aes.dtsi：EVK 的两颗传感器不再出现，
 * ap3216c@1e 直接写在 base 的 &i2c1 里。这里不用再按完整路径 /delete-node/
 * （路径不存在时 dtc 会直接报错挂构建），下面的声明和 base 里的同名同址，
 * dtc 合并成一个节点，不冲突。
 */

&i2c1 {
	/*
	 * AP3216C：IR / ALS / PS 三合一传感器，7 位从机地址 0x1e。
	 *   compatible - 必须和驱动 of_match_table 里那串一字不差，否则 probe 不触发；
	 *   reg        - 真正生效的硬件地址，写错了线上只会回 NACK。
	 * I2C1 的 SCL/SDA 引脚复用（pinctrl_i2c1）base dtsi 早就配好了，这里一行都不用动。
	 */
	ap3216c@1e {
		compatible = "imxaes,ap3216c";
		reg = <0x1e>;
	};
};
