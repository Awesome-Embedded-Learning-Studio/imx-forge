/dts-v1/;
#include "imx6ull.dtsi"
#include "imx6ull-aes.dtsi"

/ {
	model = "Awesome Embedded Studio IMX6ULL Example Driver";
	compatible = "fsl,imx6ull-14x14-evk", "fsl,imx6ull";
	/**
	 * PS 下，可以看到我们在/下追加了一个新的LED等节点
     * 这里也是我们之后寻找LED的Path /imx_aes_led
	 */
	beep {
        // PS：下面的内容可写可不写，这其实是给总线设备的。。。
		#address-cells = <1>;
		#size-cells = <1>;
        // 但是出于尊重之前的正点的教程，这里留下，但是要反复强调可以删除

		compatible = "imxaes,beep";

        pinctrl-names = "default";
        pinctrl-0 = <&pinctrl_beep>;

		status = "okay";
        // 这里是我们的GPIO，属性是自定义的，
        // 虽然实际上更标准的做法是gpios
		beep-gpios = <&gpio5 1 GPIO_ACTIVE_HIGH>;
	};
};

/*
 * pinctrl_beep 这个 pinctrl 组由共享的 imx6ull-aes.dtsi 提供（搜 pinctrl_beep:
 * beep_grp）：SNVS_TAMPER1 属于 SNVS 引脚组，归 iomuxc_snvs（bus@2000000）管，
 * 主 iomuxc（bus@2200000）管不到它。以前这里在 &iomuxc 下重复定义过一份，
 * 标签和 base 里的撞车（dtc 报 duplicate_label，本章 dtb 一直没编出来），
 * 而且把 SNVS 引脚挂在主 iomuxc 下，引脚复用本身也不会生效。
 * 引用追加语法（&iomuxc { ... }）、label、beep_grp 节点名、fsl,pins 这些
 * 关键字的样子，去 base dtsi 的 iomuxc_snvs 段看，就是刚才那段的标准写法。
 */