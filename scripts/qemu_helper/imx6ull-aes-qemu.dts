// SPDX-License-Identifier: (GPL-2.0 OR MIT)
//
// QEMU variant of the AES board device tree — FULL node parity with the
// real board tree. Every node enabled by imx6ull-aes.dts/.dtsi is enabled
// here too; nothing is disabled anymore:
//
//   - real QEMU models: uart/usdhc/gpio/i2c/ecspi/fec(×2)/gpt/epit/wdt/
//     ccm/snvs/usbphy/chipidea/eLCDIF(display)/flexcan(wired by our patch
//     0110, both controllers share one internal can-bus)
//   - unimplemented stubs (reads 0 → drivers soft-fail): mmdc/ocotp/qspi/
//     usbmisc/sai/asrc/sdma/iomuxc + dcp/rngb/pxp/csi/tsc (stubbed by our
//     patch 0100; stock 11.1 leaves those as address holes)
//
// Requires the self-built QEMU (scripts/build_helper/build-qemu.sh +
// patches/qemu/). On stock 8.2/11.1 the dcp/rngb/pxp/csi/tsc nodes would
// still hit holes — this tree no longer guards against that, run-qemu.sh
// warns when only the system QEMU is available.
//
// The only deltas vs the real tree:
//   1. model/compatible: cosmetic marker "(QEMU mcimx6ul-evk)"
//   2. local-mac-address on both fec: hardware U-Boot fixups the MAC in
//      before bootz; direct-boot QEMU has no U-Boot, and without this
//      property of_get_mac_address() waits forever on an nvmem cell and
//      both FECs sit in deferred-probe limbo.
//
// Build with the kernel's dtc:  see scripts/qemu_helper/make-qemu-dtb.sh

/dts-v1/;

#include "imx6ull.dtsi"
#include "imx6ull-aes.dtsi"

/ {
	model = "Awesome Embedded Studio IMX6ULL (QEMU mcimx6ul-evk)";
	compatible = "fsl,imx6ull-14x14-evk", "fsl,imx6ull";
};

/*
 * QEMU sizes DRAM from the -m flag and rewrites the memory node at
 * arm_load_kernel time, so no memory override is needed here.
 */

/* no U-Boot to fixup the MAC before direct boot (see header) */
&fec1 {
	local-mac-address = [00 11 22 33 44 01];
};

&fec2 {
	local-mac-address = [00 11 22 33 44 02];
};

/*
 * GPIO1_IO09 is wired twice in the real dtsi: as the SD-card power enable
 * (reg_sd1_vmmc) and as the gt9147/touch INT line. On hardware the pad
 * ends up an output held high and the touch IRQ arrives via the DT
 * interrupts property anyway; QEMU's GPIO model stays input-only for
 * IRQs, so the shared pad would swallow the touch INT. Drop the
 * regulator here — the emulated SD card needs no power switch — and
 * give the pin to the touch controller alone.
 */
&reg_sd1_vmmc {
	status = "disabled";
};
